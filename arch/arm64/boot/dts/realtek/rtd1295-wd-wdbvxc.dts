/dts-v1/;

/memreserve/	0x0000000000000000 0x0000000000100000;
/memreserve/	0x000000000001f000 0x0000000000001000;
/memreserve/	0x000000000f900000 0x0000000000500000;
/memreserve/	0x0000000001ffe000 0x0000000000004000;
/memreserve/	0x0000000002600000 0x0000000000c00000;
/memreserve/	0x0000000003200000 0x000000000b800000;
/memreserve/	0x0000000010000000 0x0000000000014000;
/memreserve/	0x0000000014200000 0x0000000003c00000;

#include "rtd-1295.dtsi"

/ {
	compatible = "realtek,rtd1295";
	model = "Monarch";

    chosen {
		//linux,initrd-start = <0x1D400000>;
		//linux,initrd-end = <0x1E396873>;
		bootargs = "loglevel=7";
	};

	memory@0 {
		device_type = "memory";
		reg = <0 0x40000000>; /* 1024 MB */
	};
};