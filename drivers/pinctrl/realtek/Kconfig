## drivers/pinctrl/realtek/Kconfig
```kconfig
config PINCTRL_RTD129x
	bool "RTD129x pin controller driver"
    default y
	select PINMUX
	select GENERIC_PINCONF
```

## drivers/soc/realtek/Kconfig
```kconfig
#
# Realtek Soc Drviers
#
menu "Realtek Soc Drviers"

config RTD129x
	bool "Realtek RTD129x SoC family specific drivers"
	depends on ARCH_RTD129x
	default y
	help
	  Realtek RTD129x SoC family specific support.

	  If unsure, say N.

source "drivers/soc/realtek/common/Kconfig"

endmenu
```

## drivers/soc/realtek/common/Kconfig
```kconfig
config RTK_SB2_MEM_TRASH_MONITOR
	bool "Realtek memory trash monitor"
	default y
	---help---
	  Enable helper functions for memory trash detection. If unsure, say N.
```
